## base_station/components/frontend_bluetooth/Kconfig
```kconfig
menu "Bluetooth Handler Configuration"

    config BLUETOOTH_DEVICE_NAME
        string "Bluetooth Device Name"
        default "Flight_Base_Station"
        help
          Set the name for the Bluetooth device. This is the name that will be broadcasted to nearby devices when the ESP32 is in Bluetooth mode.

    config BLUETOOTH_SERVICE_UUID
        hex "Bluetooth Service UUID"
        default 0xABF0
        help
          Set the UUID for the Bluetooth service. This UUID is used to identify the service provided by the ESP32.
endmenu
```

## base_station/components/wifi_helper/Kconfig
```kconfig
menu "WiFi Helper Configuration"

config WIFI_AP_SSID
    string "WiFi AP SSID"
    default "Flight_Base_Station"
    help
      Set the SSID (network name) for the WiFi Access Point (AP) mode. This is the name that will be broadcasted to nearby devices when the ESP32 is in AP mode.

config WIFI_AP_PASSWORD
    string "WiFi AP Password"
    default "password123"
    help
      Set the password for the WiFi Access Point (AP) mode. This password will be required for devices to connect to the ESP32 when it is in AP mode. Ensure that the password

config WIFI_DEV_MODE
    bool "Enable Developer Mode"
    default n
    help
      Enable this connect to an existing WiFi network in station mode. When enabled, the ESP32 will attempt to connect to a WiFi network using the SSID and password provided in the configuration. If disabled, the ESP32 will operate in Access Point (AP) mode, allowing other devices to connect to it directly.
      It will use the AP SSID and AP password defined in the configuration for AP mode to connect to the network.

config WIFI_DEV_MODE_CONNECT_TIMEOUT_SEC
    int "Dev mode WiFi connect timeout (seconds)"
    default 30
    help
      When Developer Mode is enabled, this is the maximum time (in seconds) to wait
      for the ESP32 to connect to the configured WiFi network before giving up and
      falling back to starting the Access Point instead.

config WIFI_DEVICE_HOSTNAME
    string "Device Hostname"
    default "ESP32-Flight-Base-Station"
    help
      Set the hostname for the ESP32 when it connects to a WiFi network in station mode. This is the name that will be used to identify the device on the network.

endmenu
```

## flight_controller/components/flight_controller/Kconfig
```kconfig
menu "Flight Controller Settings"

    config SEND_UPDATE_INTERVAL_MS
        int "Send Update Interval (ms)"
        default 5000
        help
         "Interval in milliseconds to send updates to the base station over lora"

    config WAYPOINT_REACHED_RADIUS_M
        int "Waypoint reached radius (meters)"
        range 5 500
        default 30
        help
          "Distance in meters within which the current waypoint is considered reached
          and the flight controller advances to the next waypoint."

    config RUDDER_SERVO_MIN
        int "Rudder servo minimum value"
        range -100 -1
        default -100
        help
          "Minimum (full left) servo control value for the rudder. Adjust to match the
          physical servo travel limit. Must be in range [-100, -1]."

    config RUDDER_SERVO_MAX
        int "Rudder servo maximum value"
        range 1 100
        default 100
        help
          "Maximum (full right) servo control value for the rudder. Adjust to match the
          physical servo travel limit. Must be in range [1, 100]."

    config ALTITUDE_SMOOTHING_SAMPLES
        int "Altitude smoothing sample count"
        range 1 50
        default 5
        help
          "Number of recent barometer-derived altitude readings averaged together
          before being used for altitude hold. Higher values smooth out sensor
          noise at the cost of a slower response to real altitude changes."

    config ROLL_SMOOTHING_SAMPLES
        int "Roll angle smoothing sample count"
        range 1 50
        default 5
        help
          "Number of recent gyroscope roll readings averaged together before
          being used for aileron control."

    config PITCH_SMOOTHING_SAMPLES
        int "Pitch angle smoothing sample count"
        range 1 50
        default 5
        help
          "Number of recent gyroscope pitch readings averaged together before
          being used for elevator/pitch control."

    config HEADING_SMOOTHING_SAMPLES
        int "Compass heading smoothing sample count"
        range 1 50
        default 5
        help
          "Number of recent magnetometer heading readings averaged together
          before being used for rudder control."

endmenu
```

## flight_controller/components/motor_com_master/Kconfig
```kconfig
menu "Motor Controller I2C Configuration"

config MOTOR_COM_I2C_ADDRESS
    hex "I2C address of the motor controller"
    default 0x42
    help
      Set the I2C address of the motor controller. Ensure this matches the address configured on the motor controller device.

endmenu
```

## shared_components/gps/Kconfig
```kconfig
menu "GPS Settings"

config GPS_PIN_RX
    int "GPS RX pin"
    default 39
    help
      Set the GPIO pin number for the GPS RX (receive) line. This is the pin that will receive data from the GPS module.

config GPS_PIN_TX
    int "GPS TX pin"
    default 6
    help
      Set the GPIO pin number for the GPS TX (transmit) line. This is the pin that will send data to the GPS module.


config GPS_UART_NUM
    int "GPS UART number"
    default 2
    help
      Set the UART number for the GPS module. ESP32 typically has multiple UARTs (e.g., UART0, UART1, UART2), and you can choose which one to use for communication with the GPS module.

endmenu
```

## shared_components/i2c_manager/Kconfig
```kconfig
menu "I2C Manager Settings"

    config I2C_PIN_SDA
        int "I2C SDA Pin Number"
        default 47
        help
            GPIO pin number for I2C SDA line. Common defaults:
            - 21: ESP32 default SDA pin
            - 4: Alternative SDA pin


    config I2C_PIN_SCL
        int "I2C SCL Pin Number"
        default 48
        help
            GPIO pin number for I2C SCL line. Common defaults:
            - 22: ESP32 default SCL pin
            - 5: Alternative SCL pin

endmenu
```

## shared_components/lora_com/Kconfig
```kconfig
menu "LoRa Communication Settings"

    config LORA_FREQUENCY
        int "LoRa Frequency (Hz)"
        default 868000000
        help
            Carrier frequency in Hz. Common ISM bands:
            - 433 MHz: 433e6 (Europe, Asia)
            - 868 MHz: 868e6 (Europe)
            - 915 MHz: 915e6 (Americas, Australia)

    config LORA_TX_POWER
        int "LoRa TX Power Level (2-17)"
        default 17
        range 2 17
        help
            Transmission power level. Higher = more power consumption & range.
            - 2: Minimum power (lowest consumption)
            - 17: Maximum power (longest range)

    config LORA_SPREADING_FACTOR
        int "LoRa Spreading Factor (6-12)"
        default 7
        range 6 12
        help
            Spreading factor controls range vs. speed tradeoff:
            - SF6-7: ~2 km, fast transmission
            - SF9: ~5 km, balanced
            - SF10-12: ~15 km, slow but very robust
            All devices must use same SF to communicate.

    config LORA_BANDWIDTH
        int "LoRa Bandwidth (Hz)"
        default 125000
        help
            Bandwidth in Hz. Options: 7800, 10400, 15600, 20800, 31250, 41700, 62500, 125000, 250000
            - 62500: Long range, slow data
            - 125000: Standard, balanced (recommended)
            - 250000: Short range, fast data

    config LORA_CODING_RATE_DENOMINATOR
        int "LoRa Coding Rate Denominator (5-8)"
        default 6
        range 5 8
        help
            Coding rate = 4/X (X is the denominator).
            Higher = more error correction, slower transmission:
            - 5: 4/5 (25% overhead, fastest)
            - 6: 4/6 (50% overhead, balanced - recommended)
            - 7: 4/7 (75% overhead, more robust)
            - 8: 4/8 (100% overhead, maximum error correction)

    config LORA_PREAMBLE_LENGTH
        int "LoRa Preamble Length (symbols)"
        default 8
        help
            Preamble symbols for packet detection.
            - 8: Standard (recommended)
            - Higher values increase detection range but use more energy

    config LORA_PING_INTERVAL
        int "LoRa Ping Interval (seconds)"
        default 30
        range 5 300
        help
            Send a PING packet if no data was sent for this duration.
            Keeps the link alive and detects disconnections.
            - 5-10 seconds: Frequent keepalive (high overhead)
            - 30 seconds: Balanced (recommended)
            - 60+ seconds: Low overhead but slower detection

    config LORA_DIO0_PIN
        int "LoRa DIO0 Pin Number"
        default 14
        help
            GPIO pin number connected to LoRa DIO0 (used for interrupts).
            - Set to -1 if not used or if using a different pin for interrupts.

    config LORA_CS_GPIO
        int "CS GPIO"
        range 0 35
        default 8
        help
            Pin Number where the NCS pin of the LoRa module is connected to.

    config LORA_RST_GPIO
        int "RST GPIO"
        range 0 35
        default 12
        help
            Pin Number where the NRST pin of the LoRa module is connected to.

    config LORA_MISO_GPIO
        int "MISO GPIO"
        range 0 35
        default 11
        help
            Pin Number to be used as the MISO SPI signal.

    config LORA_MOSI_GPIO
        int "MOSI GPIO"
        range 0 35
        default 10
        help
            Pin Number to be used as the MOSI SPI signal.

    config LORA_SCK_GPIO
        int "SCK GPIO"
        range 0 35
        default 9
        help
            Pin Number to be used as the SCK SPI signal.

    config LORA_BUSY_GPIO
        int "Busy GPIO"
        range 0 35
        default 13
        help
            Pin Number to check if the lora module is busy.

    config LORA_SYNC_WORD
        hex "LoRa Sync Word"
        default 0x34
        help
            Sync word for LoRa communication. Must match between devices.
            - 0x34: Default sync word for private networks (recommended)
            - 0x12: Sync word for LoRaWAN public networks

endmenu
```

## shared_components/magnetometer/Kconfig
```kconfig
menu "Magnetometer"

    choice MAGNETOMETER_DRIVER
        prompt "Magnetometer driver"
        default MAGNETOMETER_DRIVER_QMC5883P_EIL
        help
            Selects which sensor driver the Magnetometer helper uses.

        config MAGNETOMETER_DRIVER_HMC5883L
            bool "HMC5883L (esp-idf-lib hmc5883l)"

        config MAGNETOMETER_DRIVER_QMC5883P_DURUOFU
            bool "QMC5883P (duruofu qmc5883p)"

        config MAGNETOMETER_DRIVER_QMC5883P_EIL
            bool "QMC5883P (qmc5883p_eil)"
    endchoice

endmenu
```

## shared_components/oled_display/Kconfig
```kconfig
menu "OLED Display Settings"

    config OLED_PIN_SDA
        int "OLED SDA Pin"
        default 17
        help
            GPIO pin number for the OLED display's dedicated I2C SDA line.
            This bus is separate from the shared I2C Manager bus.

    config OLED_PIN_SCL
        int "OLED SCL Pin"
        default 18
        help
            GPIO pin number for the OLED display's dedicated I2C SCL line.
            This bus is separate from the shared I2C Manager bus.

    config OLED_PIN_RESET
        int "OLED Reset Pin"
        default 21
        help
            GPIO pin wired to the OLED's hardware reset line (RST_OLED on
            Heltec WiFi LoRa32 V3 boards). Without toggling this pin the panel
            never leaves reset and silently fails to ACK on the I2C bus.
            Set to -1 if the display has no dedicated reset pin.

    config OLED_PIN_VEXT
        int "OLED Vext (power enable) Pin"
        default 36
        help
            GPIO pin controlling the Vext power rail that feeds the OLED on
            Heltec boards. Driven LOW to switch the rail on. Without this the
            display has no power at all. Set to -1 if the board has no Vext
            switch (display is always powered).

    config OLED_REQUIRE_UNSCII_8_FONT
        bool
        default y
        select LV_FONT_UNSCII_8
        help
            Forces LVGL's unscii_8 bitmap font on. Anti-aliased fonts (e.g. the
            default Montserrat) render almost invisibly on 1bpp displays,
            since LVGL's I1 blend only lights a pixel at 100% coverage; a
            crisp, non-anti-aliased bitmap font is needed instead.

endmenu
```

## shared_components/qmc5883p_eil/Kconfig
```kconfig
menu "QMC5883P (esp-idf-lib style)"

config QMC5883P_EIL_MEAS_TIMEOUT
    int "Single measurement timeout, microseconds"
    default 10000
    range 500 20000

endmenu
```

## vision_controller/components/camera/Kconfig
```kconfig
menu "Camera"

    config CAMERA_FOV
        int "Camera Field of View (FOV)"
        default 90
        help
          Set the field of view for the camera in degrees. This determines how wide the camera can see.

    config CAMERA_MAX_DISTANCE
        int "Camera Maximum Distance"
        default 20
        help
          Set the maximum distance the camera can capture. This is useful for limiting the range of the camera.

    config CAMERA_RESOLUTION_X
        int "Camera Resolution X"
        default 640
        help
          Set the horizontal resolution of the camera in pixels.

    config CAMERA_RESOLUTION_Y
        int "Camera Resolution Y"
        default 480
        help
          Set the vertical resolution of the camera in pixels.

endmenu
```
